## Config.in
```kconfig
menu "SC ADAT appliance packages"
source "$BR2_EXTERNAL_SC_ADAT_APPLIANCE_PATH/package/supercollider-headless/Config.in"
source "$BR2_EXTERNAL_SC_ADAT_APPLIANCE_PATH/package/sc-adat-kernel-probes/Config.in"
source "$BR2_EXTERNAL_SC_ADAT_APPLIANCE_PATH/package/sc-adat-jack-probe/Config.in"
endmenu
```

## configs/sc_adat_defconfig
```kconfig
BR2_x86_64=y
BR2_KERNEL_HEADERS_6_12=y
BR2_TOOLCHAIN_BUILDROOT_MUSL=y
BR2_TOOLCHAIN_BUILDROOT_CXX=y
BR2_TARGET_GENERIC_HOSTNAME="sc-adat"
BR2_TARGET_GENERIC_ISSUE="SC-ADAT native candidate"
BR2_TARGET_GENERIC_GETTY_PORT="ttyS0"
BR2_TARGET_GENERIC_GETTY_BAUDRATE_115200=y
BR2_SYSTEM_BIN_SH_BUSYBOX=y
BR2_INIT_BUSYBOX=y
BR2_ROOTFS_DEVICE_CREATION_DYNAMIC_DEVTMPFS=y
BR2_ROOTFS_OVERLAY="$(BR2_EXTERNAL_SC_ADAT_APPLIANCE_PATH)/board/dell-optiplex-7010/rootfs-overlay"
BR2_ROOTFS_POST_BUILD_SCRIPT="$(BR2_EXTERNAL_SC_ADAT_APPLIANCE_PATH)/board/dell-optiplex-7010/post-build.sh"
BR2_LINUX_KERNEL=y
BR2_LINUX_KERNEL_CUSTOM_VERSION=y
BR2_LINUX_KERNEL_CUSTOM_VERSION_VALUE="6.12.107"
BR2_LINUX_KERNEL_USE_CUSTOM_CONFIG=y
BR2_LINUX_KERNEL_CUSTOM_CONFIG_FILE="$(BR2_EXTERNAL_SC_ADAT_APPLIANCE_PATH)/board/dell-optiplex-7010/linux.config"
BR2_LINUX_KERNEL_CONFIG_FRAGMENT_FILES="$(BR2_EXTERNAL_SC_ADAT_APPLIANCE_PATH)/board/dell-optiplex-7010/linux-rt.fragment"
BR2_LINUX_KERNEL_X86_64=y
BR2_LINUX_KERNEL_NEEDS_HOST_OPENSSL=y
BR2_TARGET_ROOTFS_INITRAMFS=y
BR2_TARGET_ROOTFS_CPIO=y
BR2_TARGET_ROOTFS_CPIO_GZIP=y
BR2_TARGET_ROOTFS_INITRAMFS_USE_CPIO=y
BR2_PACKAGE_ALSA_LIB=y
BR2_PACKAGE_ALSA_UTILS=y
BR2_PACKAGE_ALSA_UTILS_APLAY=y
BR2_PACKAGE_JACK2=y
BR2_PACKAGE_LIBSAMPLERATE=y
BR2_PACKAGE_LIBSNDFILE=y
BR2_PACKAGE_DROPBEAR=y
BR2_PACKAGE_DROPBEAR_LOCALOPTIONS_FILE="$(BR2_EXTERNAL_SC_ADAT_APPLIANCE_PATH)/board/dell-optiplex-7010/dropbear-localoptions.h"
BR2_PACKAGE_IPROUTE2=y
BR2_PACKAGE_DHCPCD=y
BR2_PACKAGE_PROCPS_NG=y
BR2_PACKAGE_PCIUTILS=y
BR2_PACKAGE_BUSYBOX_SHOW_OTHERS=y
BR2_PACKAGE_SUPERCOLLIDER_HEADLESS=y
BR2_TARGET_GENERIC_REMOUNT_ROOTFS_RW=n
BR2_TARGET_GENERIC_GETTY=y
BR2_TARGET_GENERIC_GETTY_TERM="linux"
BR2_TARGET_GENERIC_GETTY_OPTIONS="-L"
BR2_TARGET_GENERIC_ENABLE_ROOT_LOGIN=y
BR2_TARGET_GENERIC_ENABLE_GETTY=y
```

## package/sc-adat-jack-probe/Config.in
```kconfig
config BR2_PACKAGE_SC_ADAT_JACK_PROBE
    bool "sc-adat JACK runtime probe"
    depends on BR2_PACKAGE_JACK2
    help
      Small target-native probe for JACK rate, period and port topology.
```

## package/sc-adat-kernel-probes/Config.in
```kconfig
config BR2_PACKAGE_SC_ADAT_KERNEL_PROBES
	bool "sc-adat-kernel-probes"
	help
	  Small runtime checks for kernel facilities required by the appliance.
```

## package/sc-adat-recorder/Config.in
```kconfig
config BR2_PACKAGE_SC_ADAT_RECORDER
	bool "sc-adat independent JACK recorder"
	depends on BR2_PACKAGE_JACK2 && BR2_PACKAGE_LIBSNDFILE && BR2_PACKAGE_PYTHON3 && BR2_PACKAGE_ALSA_UTILS && BR2_PACKAGE_UTIL_LINUX
	help
	  Independent JACK capture client plus mixer control-plane recorder manager,
	  status policy, config and shared OSC controller modules.
```

## package/sc-adat-tone-test/Config.in
```kconfig
config BR2_PACKAGE_SC_ADAT_TONE_TEST
    bool "SC-ADAT tone test"
    depends on BR2_PACKAGE_JACK2
    depends on BR2_PACKAGE_SUPERCOLLIDER_HEADLESS
    help
      Native headless 24-channel ADAT test controller and OSC sender.
```

## package/supercollider-headless/Config.in
```kconfig
config BR2_PACKAGE_SUPERCOLLIDER_HEADLESS
	bool "supercollider-headless"
	depends on BR2_INSTALL_LIBSTDCPP
	depends on BR2_PACKAGE_ALSA_LIB
	depends on BR2_PACKAGE_JACK2
	depends on BR2_PACKAGE_LIBSAMPLERATE
	depends on BR2_PACKAGE_LIBSNDFILE
	help
	  Headless SuperCollider components for the ADAT appliance.

	  This package is intentionally not selectable until its version,
	  dependencies, build options, and hashes have been validated.
```
